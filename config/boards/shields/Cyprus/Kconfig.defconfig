## config/boards/shields/Cyprus/Kconfig.defconfig
```kconfig
if SHIELD_CYPRUS_LEFT

# Name must be less than 16 characters long!

config ZMK_KEYBOARD_NAME
    default "Cyprus"

config ZMK_SPLIT_ROLE_CENTRAL
    default y

endif

if SHIELD_CYPRUS_LEFT || SHIELD_CYPRUS_RIGHT

config ZMK_SPLIT
    default y

endif
```

## config/boards/shields/Cyprus/Kconfig.shield
```kconfig
config SHIELD_CYPRUS_LEFT
  def_bool $(shields_list_contains,Cyprus_left)

config SHIELD_CYPRUS_RIGHT
  def_bool $(shields_list_contains,Cyprus_right)
```
